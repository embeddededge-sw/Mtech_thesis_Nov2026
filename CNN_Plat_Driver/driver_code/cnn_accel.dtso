// SPDX-License-Identifier: GPL-2.0
/*
 * Device tree overlay for CNN accelerator on Kria KV260
 *
 * Usage:
 *   dtc -O dtb -o cnn_accel.dtbo cnn_accel.dtso
 *   mkdir -p /sys/kernel/config/device-tree/overlays/cnn
 *   cat cnn_accel.dtbo > /sys/kernel/config/device-tree/overlays/cnn/dtbo
 */

/dts-v1/;
/plugin/;

&fpga_axi {
    cnn_accel: cnn@a0000000 {
        compatible = "custom,cnn-accel";
        reg = <0x0 0xa0000000 0x0 0x40000>;
        /* Uncomment and adjust if the HLS IP has an interrupt line */
        /* interrupts = <0 89 4>; */
    };
};
